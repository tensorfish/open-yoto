## firmware/main/Kconfig.projbuild
```kconfig
menu "open-yoto Application"

    config APP_TEST_MODE
        bool "Build the boot test firmware"
        default n
        help
            Build a minimal test firmware that displays an image and emits a
            repeating beep on boot. Intended for hardware bring-up only.

    config APP_SCAN_MODE
        bool "Build the I2C bus scanner firmware"
        default n
        help
            Build a bring-up firmware that enumerates the I2C bus (SDA=21,
            SCL=25) and logs every responding 7-bit address, then idles.
            Use it to identify the unit's hardware revision before porting
            the full firmware.

    config APP_DISPLAY_TEST_ICON
        bool "Render requested external PNG at boot"
        default n
        help
            Replace the stock low-SOC asset with the generated 16x16 RGBA
            frame from the current display test icon. Bring-up only.

    config APP_SPEAKER_TEST_TONE
        bool "Play a speaker test tone at boot"
        default n
        help
            Start a repeating 440 Hz I2S tone after boot. The left encoder
            controls its PCM volume. Intended for speaker-path bring-up; it
            stops when normal content playback starts.

    config BOARD_REV_04
        bool "Target hardware revision #04 (TFT, single IOX)"
        default n
        help
            Select the older #04 board: GC9306 TFT, single IO expander
            (0x20), ES8156 at 0x08, SDMMC 4-bit. Default (n) targets rev #05:
            HT16D35x LED matrix, dual IOX (0x20/0x21), ES8156 at 0x09.

endmenu
```
